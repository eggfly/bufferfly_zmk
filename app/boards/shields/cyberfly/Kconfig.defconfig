## app/boards/shields/cyberfly/Kconfig.defconfig
```kconfig
# Copyright (c) 2025 The ZMK Contributors
# SPDX-License-Identifier: MIT

if SHIELD_CYBERFLY

config ZMK_KEYBOARD_NAME
    default "CyberFly"

endif
```

## app/dts/bindings/behaviors/cyberfly,behavior-smart-space.yaml
```yaml
description: Smart space - sends space normally, mouse L/R click when mouse mode is on

compatible: "cyberfly,behavior-smart-space"

include: one_param.yaml
```
